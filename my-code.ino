/*
  Mein CYD Projekt
   Erstellt mit CYD UI Builder
  Bibliotheken installieren: Adafruit GFX Library, Adafruit ILI9341, XPT2046_Touchscreen
*/
#include <SPI.h>
#include <Adafruit_GFX.h>
#include <Adafruit_ILI9341.h>
#include <XPT2046_Touchscreen.h>
const char* ssid = "EasyBox-280186";
const char* password = "QKKFcNrmdzMmLSkU";
// Häufige Cheap-Yellow-Display-Pins — bei abweichender Hardware im Builder ändern.
#define TFT_CS    15
#define TFT_DC    2
#define TFT_RST   -1
#define TOUCH_CS  33
#define XPT2046_IRQ 36
#define XPT2046_MOSI 32
#define XPT2046_MISO 39
#define XPT2046_CLK 25
#define XPT2046_CS 33

Adafruit_ILI9341 tft = Adafruit_ILI9341(TFT_CS, TFT_DC, -1);
SPIClass touchscreenSPI = SPIClass(VSPI);
XPT2046_Touchscreen ts(XPT2046_CS, XPT2046_IRQ);

enum PageId {
  PAGE_PAGE_HOME,
  PAGE_PAGE_MSEFFRPG,
  PAGE_PAGE_MSEFX142,
  PAGE_PAGE_MSEG45TI,
  PAGE_PAGE_MSEUGJJT,
  PAGE_PAGE_MSEUUDL2,
  PAGE_PAGE_MSEUXM3Z,
  PAGE_PAGE_MSG02TJ0,
  PAGE_PAGE_MSK15DJY,
  PAGE_PAGE_MSOPVRT5,
  PAGE_PAGE_MSORFAVX,
  PAGE_PAGE_MSOSZIHG,
  PAGE_PAGE_MSQ16QOV,
  PAGE_PAGE_MSQ1DRU6
};
PageId currentPage = PAGE_PAGE_HOME;

volatile int fortschritt_boot = 0;
volatile int temp1 = 31;
volatile int hum1 = 65;
unsigned long codeAPI1 = 0;
volatile int time_hour = 12;
volatile int time_min = 0;
unsigned long time1 = 0;
const char* listSelected_items[] = {"Standort ->", "Updates  ->", "Zeit     ->", "</> Entwickler"};
const int listSelected_itemCount = 4;
volatile int listSelected = 0;
char stadt[32] = "";
char frage[63] = "";
const char* listSelected123_items[] = {"Reboot", "Wipe Data", "Unlock the Bootloader", "TBS Info"};
const int listSelected123_itemCount = 4;
volatile int listSelected123 = 0;
char WLANSSID[32] = "";
char WLANPASSWORD[32] = "";
volatile bool checkboxState123 = true;
// Globale Deklarationen hier
void confirmDialog(const char* text) {
  tft.fillRect(30, 30, 250, 180, ILI9341_RED);
  tft.drawRect(30, 30, 250, 180, ILI9341_BLACK);
  drawMultilineText(35, 35, 200,"Das Betriebssystem hat Ihre Zustimmung erbeten.\nWird in 5 Sek. autorisiert...", 0xFFFF, 1, 4);
  drawMultilineText(35, 100, 200,text, 0xFFFF, 1, 4);
delay(5000);
}
void textWindow(const char* text) {
  tft.fillRect(30, 30, 250, 180, ILI9341_BLUE);
  tft.drawRect(30, 30, 250, 180, ILI9341_BLACK);
  drawMultilineText(35, 35, 200,text, 0xFFFF, 1, 4);

delay(5000);
}
void textWindowRunning(const char* text) {
  tft.fillRect(30, 30, 250, 180, ILI9341_BLUE);
  tft.drawRect(30, 30, 250, 180, ILI9341_BLACK);
  drawMultilineText(35, 35, 200,text, 0xFFFF, 1, 4);


}
// Globale Deklarationen hier
char* antwort = "";
// Globale Deklarationen hier
String transcript = "Nichts";
// Globale Deklarationen hier
#include <ArduinoOTA.h>

void enterFlashMode() {
  Serial.println("Starte Flash-Modus...");

  WiFi.mode(WIFI_STA);
  WiFi.begin(ssid, password);

  Serial.print("Verbinde mit WLAN");

  unsigned long start = millis();

  while (WiFi.status() != WL_CONNECTED) {
    delay(250);
    Serial.print(".");

    // Nach 15 Sekunden abbrechen
    if (millis() - start > 15000) {
      Serial.println("\nWLAN-Verbindung fehlgeschlagen!");
      return;
    }
  }

  Serial.println();
  Serial.println("WLAN verbunden.");
  Serial.print("IP-Adresse: ");
  Serial.println(WiFi.localIP());
  textWindowRunning(String(WiFi.localIP()).c_str());
  ArduinoOTA.setHostname("ESP32-Flash");

  ArduinoOTA.onStart([]() {
    Serial.println("Flash-Vorgang gestartet...");
  });

  ArduinoOTA.onEnd([]() {
    Serial.println("\nFlash-Vorgang abgeschlossen!");
  });

  ArduinoOTA.onProgress([](unsigned int progress, unsigned int total) {
    Serial.printf("Flash: %u%%\r", (progress * 100) / total);
  });

  ArduinoOTA.onError([](ota_error_t error) {
    Serial.printf("\nOTA-Fehler: %u\n", error);
  });

  ArduinoOTA.begin();

  Serial.println("================================");
  Serial.println("ESP32 ist jetzt im Flash-Modus!");
  Serial.println("================================");

  // Im Flash-Modus bleiben
  while (true) {
    ArduinoOTA.handle();
    delay(1);
  }
}


#include <Adafruit_NeoPixel.h>

#define MATRIX_PIN   27
#define MATRIX_LEDS  25
#define MATRIX_W      5
#define MATRIX_H      5

Adafruit_NeoPixel matrix(
  MATRIX_LEDS,
  MATRIX_PIN,
  NEO_GRB + NEO_KHZ800
);


// --------------------------------------------------
// Matrix initialisieren
// --------------------------------------------------

void initMatrix() {
  matrix.begin();
  matrix.setBrightness(40);
  matrix.clear();
  matrix.show();
}


// --------------------------------------------------
// LED-Index für deine Serpentinen-Verdrahtung
// --------------------------------------------------

int matrixIndex(int x, int y) {

  if (x < 0 || x >= MATRIX_W ||
      y < 0 || y >= MATRIX_H)
    return -1;

  // Jede zweite Reihe ist umgedreht
  if (y & 1)
    x = MATRIX_W - 1 - x;

  return y * MATRIX_W + x;
}


// --------------------------------------------------
// 5x5-Schrift
// --------------------------------------------------

const byte fontH[5] = {
  0b10001,
  0b10001,
  0b11111,
  0b10001,
  0b10001
};

const byte fontA[5] = {
  0b01110,
  0b10001,
  0b11111,
  0b10001,
  0b10001
};

const byte fontL[5] = {
  0b10000,
  0b10000,
  0b10000,
  0b10000,
  0b11111
};

const byte fontO[5] = {
  0b01110,
  0b10001,
  0b10001,
  0b10001,
  0b01110
};

const byte fontW[5] = {
  0b10001,
  0b10001,
  0b10101,
  0b10101,
  0b01010
};

const byte fontE[5] = {
  0b11111,
  0b10000,
  0b11110,
  0b10000,
  0b11111
};

const byte fontT[5] = {
  0b11111,
  0b00100,
  0b00100,
  0b00100,
  0b00100
};


// --------------------------------------------------
// Farbe: langsam durch den Farbkreis
// --------------------------------------------------

uint32_t matrixColor(byte hue) {

  if (hue < 85) {
    return matrix.Color(
      255 - hue * 3,
      hue * 3,
      0
    );
  }

  if (hue < 170) {
    hue -= 85;

    return matrix.Color(
      0,
      255 - hue * 3,
      hue * 3
    );
  }

  hue -= 170;

  return matrix.Color(
    hue * 3,
    0,
    255 - hue * 3
  );
}


// --------------------------------------------------
// Einen Buchstaben zeichnen
// --------------------------------------------------

void drawMatrixChar(
  const byte character[5],
  int offsetX,
  uint32_t color
) {

  for (int y = 0; y < 5; y++) {

    for (int x = 0; x < 5; x++) {

      if (character[y] & (1 << (4 - x))) {

        int px = offsetX + x;
        int index = matrixIndex(px, y);

        if (index >= 0)
          matrix.setPixelColor(index, color);
      }
    }
  }
}


// --------------------------------------------------
// "HALLO WELT"
// --------------------------------------------------

void writeHello() {

  static int scroll = MATRIX_W;
  static uint8_t hue = 0;
  static unsigned long lastFrame = 0;

  // 25 FPS
  const unsigned long frameTime = 1000 / 25;

  unsigned long now = millis();

  if (now - lastFrame < frameTime)
    return;

  lastFrame = now;

  // Farbe unabhängig vom Text verändern
  hue++;

  uint32_t color = matrixColor(hue);

  matrix.clear();

  /*
       HALLO WELT

       Jeder Buchstabe = 5 Pixel breit
       + 1 Pixel Abstand
  */

  const byte* text[] = {
    fontH,
    fontA,
    fontL,
    fontL,
    fontO,
    nullptr,
    fontW,
    fontE,
    fontL,
    fontT
  };

  const int textLength = 10;

  for (int i = 0; i < textLength; i++) {

    // Leerzeichen
    if (text[i] == nullptr)
      continue;

    int x = scroll + i * 6;

    drawMatrixChar(
      text[i],
      x,
      color
    );
  }

  matrix.show();

  // Laufschrift
  scroll--;

  // 10 Zeichen × 6 Pixel
  const int textWidth = textLength * 6;

  if (scroll < -textWidth)
    scroll = MATRIX_W;
}
const uint8_t bitmap_msoqagwmwuz8_data[] PROGMEM = {0x00, 0x00, 0x00, 0x00, 0x00, 0x00, 0x00, 0x00, 0x00, 0x00, 0x00, 0x00, 0x00,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 0x00, 0x00};
const uint8_t bitmap_msosfnntgvrw_data[] PROGMEM = {0xFF, 0xFF, 0xFF, 0xFF, 0xFF, 0xFF, 0xFF, 0xFF, 0xFF, 0xFF, 0xFF, 0xFF, 0x80,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 0xFF, 0xFF};
const uint8_t bitmap_msoszk9abbgl_data[] PROGMEM = {0xFF, 0xFF, 0xFF, 0xFF, 0xFF, 0xFF, 0xFF, 0xFF, 0xFF, 0xFF, 0xFF, 0xFF, 0xC0,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 0xFF, 0xFF};
const uint8_t bitmap_msoszphm41eu_data[] PROGMEM = {0xFF, 0xFF, 0xFF, 0xFF, 0xFF, 0xFF, 0xFF, 0xFF, 0xFF, 0xFF, 0xFF, 0xFF, 0xF8,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 0xFF, 0xFF};
volatile int rainChance = 0;
unsigned long weatherTimer_weatherRainChance_msoqdwjy5zxj = 0;
volatile int temperatureMinimum = 0;
unsigned long weatherTimer_weatherTemperature_msoqf17cka3a = 0;
volatile int temperatureMaximum = 0;
unsigned long weatherTimer_weatherTemperature_msoqg3507efu = 0;
int16_t touchStartX = 0;
int16_t touchStartY = 0;
int16_t touchLastX = 0;
int16_t touchLastY = 0;
bool touchActive = false;
bool keyboardActive = false;
char* keyboardTarget = nullptr;
uint8_t keyboardTargetSize = 0;


#ifndef ILI9341_GRAY
#define ILI9341_GRAY 0x8410
#endif
#include <WiFiClientSecure.h>
#include "driver/i2s.h"

#define TTS_SAMPLE_RATE 16000

void initSpeaker() {
  i2s_driver_uninstall(I2S_NUM_0);

  i2s_config_t i2s_config = {
    .mode = (i2s_mode_t)(I2S_MODE_MASTER | I2S_MODE_TX | I2S_MODE_DAC_BUILT_IN),
    .sample_rate = TTS_SAMPLE_RATE,
    .bits_per_sample = I2S_BITS_PER_SAMPLE_16BIT,
    .channel_format = I2S_CHANNEL_FMT_ONLY_RIGHT,
    .communication_format = I2S_COMM_FORMAT_STAND_MSB,
    .intr_alloc_flags = 0,
    .dma_buf_count = 8,
    .dma_buf_len = 256,
    .use_apll = false
  };

  esp_err_t err = i2s_driver_install(I2S_NUM_0, &i2s_config, 0, NULL);
  if (err != ESP_OK) {
    Serial.printf("I2S Install fehlgeschlagen, Fehlercode: %d\n", err);
    return;
  }

  // WICHTIG: i2s_set_pin(NULL) NICHT aufrufen -- das würde auch GPIO25 (Touch T_CLK) belegen.
  // i2s_set_dac_mode allein aktiviert gezielt nur GPIO26.
  i2s_set_dac_mode(I2S_DAC_CHANNEL_RIGHT_EN);

  Serial.println("I2S-Speaker erfolgreich initialisiert.");
}
#include <WiFi.h>
#include <HTTPClient.h>
#include <ArduinoJson.h>
volatile bool developerMode = false;
#include "driver/adc.h"
#include "esp_adc_cal.h"

#define MIC_ADC_CHANNEL ADC1_CHANNEL_7  // entspricht GPIO27
#define SAMPLE_RATE 8000
#define RECORD_SECONDS 5
#define NUM_SAMPLES (SAMPLE_RATE * RECORD_SECONDS)

int16_t* audioBuffer = nullptr;  // wird zur Laufzeit alloziert
size_t audioBufferLen = 0;
void initMicADC() {
  adc1_config_width(ADC_WIDTH_BIT_12);
  adc1_config_channel_atten(MIC_ADC_CHANNEL, ADC_ATTEN_DB_12); // 0-3.3V Bereich
}
bool recordAudio() {
  const size_t bufferBytes = NUM_SAMPLES * sizeof(int16_t);

  // Vorher aufräumen, falls schon was allokiert war
  if (audioBuffer != nullptr) {
    free(audioBuffer);
    audioBuffer = nullptr;
  }

  audioBuffer = (int16_t*) malloc(bufferBytes);
  if (audioBuffer == nullptr) {
    Serial.println("Fehler: Kein RAM für Audio-Buffer frei!");
    return false;
  }

  Serial.println("Aufnahme läuft...");
  const uint32_t sampleIntervalUs = 1000000UL / SAMPLE_RATE;

  for (int i = 0; i < NUM_SAMPLES; i++) {
    uint32_t start = micros();

    int raw = adc1_get_raw(MIC_ADC_CHANNEL);       // 0-4095
    audioBuffer[i] = (int16_t)((raw - 2048) * 16);  // zentrieren + auf 16-bit skalieren

    // Auf exakten Sample-Takt warten
    while (micros() - start < sampleIntervalUs) {
      // busy-wait für stabiles Timing
    }
  }

  audioBufferLen = bufferBytes;
  Serial.println("Aufnahme fertig.");
  return true;
}
uint8_t* buildWavFile(size_t &outLen) {
  const uint32_t dataSize = audioBufferLen;
  const uint32_t fileSize = 36 + dataSize;
  outLen = 44 + dataSize;

  uint8_t* wav = (uint8_t*) malloc(outLen);
  if (wav == nullptr) return nullptr;

  uint8_t header[44] = {
    'R','I','F','F', 0,0,0,0, 'W','A','V','E',
    'f','m','t',' ', 16,0,0,0,       // Subchunk1Size
    1,0,                             // AudioFormat = PCM
    1,0,                             // NumChannels = mono
    0,0,0,0,                         // SampleRate (wird unten gesetzt)
    0,0,0,0,                         // ByteRate
    2,0,                             // BlockAlign
    16,0,                            // BitsPerSample
    'd','a','t','a', 0,0,0,0         // Subchunk2Size
  };

  *(uint32_t*)(header + 4)  = fileSize;
  *(uint32_t*)(header + 24) = SAMPLE_RATE;
  *(uint32_t*)(header + 28) = SAMPLE_RATE * 2; // ByteRate = SampleRate * NumChannels * BitsPerSample/8
  *(uint32_t*)(header + 40) = dataSize;

  memcpy(wav, header, 44);
  memcpy(wav + 44, audioBuffer, dataSize);

  return wav;
}
String sendToGroqSTT(const char* apiKey) {
  size_t wavLen;
  uint8_t* wavData = buildWavFile(wavLen);
  if (wavData == nullptr) {
    return "FEHLER: Konnte WAV nicht bauen";
  }

  HTTPClient http;
  http.begin("https://api.groq.com/openai/v1/audio/transcriptions");
  http.addHeader("Authorization", String("Bearer ") + apiKey);

  String boundary = "----ESP32Boundary";
  String header = "--" + boundary + "\r\n"
    "Content-Disposition: form-data; name=\"model\"\r\n\r\n"
    "whisper-large-v3-turbo\r\n"
    "--" + boundary + "\r\n"
    "Content-Disposition: form-data; name=\"file\"; filename=\"audio.wav\"\r\n"
    "Content-Type: audio/wav\r\n\r\n";
  String footer = "\r\n--" + boundary + "--\r\n";

  size_t totalLen = header.length() + wavLen + footer.length();
  uint8_t* body = (uint8_t*) malloc(totalLen);
  if (body == nullptr) {
    free(wavData);
    return "FEHLER: Kein RAM fürs HTTP-Body";
  }

  size_t pos = 0;
  memcpy(body + pos, header.c_str(), header.length()); pos += header.length();
  memcpy(body + pos, wavData, wavLen); pos += wavLen;
  memcpy(body + pos, footer.c_str(), footer.length()); pos += footer.length();

  http.addHeader("Content-Type", "multipart/form-data; boundary=" + boundary);
  int httpCode = http.POST(body, totalLen);

  String result;
  if (httpCode == 200) {
    result = http.getString();
  } else {
    result = "FEHLER: HTTP " + String(httpCode) + " - " + http.getString();
  }

  free(wavData);
  free(body);
  http.end();
  return result;
}
void freeAudioBuffer() {
  if (audioBuffer != nullptr) {
    free(audioBuffer);
    audioBuffer = nullptr;
    audioBufferLen = 0;
  }
}
// WLAN-Zugangsdaten

// Koordinaten (Standard: Stuttgart) - anpassen falls gewünscht
// Statt fester Koordinaten:
const char* cityName = "Zwickau";
#include <WiFiClientSecure.h>
#include <HTTPClient.h>
#include <ArduinoJson.h>

#define GROQ_RESPONSE_BUFFER_SIZE 256
char groqResponseBuffer[GROQ_RESPONSE_BUFFER_SIZE];

char* askGroq(const char* apiKey, const char* question, const char* sysprompt) {
  WiFiClientSecure client;
  client.setInsecure(); // Für Produktivbetrieb besser Root-CA setzen

  HTTPClient https;
  strcpy(groqResponseBuffer, ""); // Buffer zurücksetzen

  if (https.begin(client, "https://api.groq.com/openai/v1/chat/completions")) {
    https.addHeader("Content-Type", "application/json");
    https.addHeader("Authorization", String("Bearer ") + apiKey);

    JsonDocument doc;
    doc["model"] = "llama-3.3-70b-versatile";
    JsonArray messages = doc["messages"].to<JsonArray>();
	
	    // Systemprompt hinzufügen
    JsonObject systemMsg = messages.add<JsonObject>();
    systemMsg["role"] = "system";
    systemMsg["content"] = sysprompt;
    JsonObject msg = messages.add<JsonObject>();
    msg["role"] = "user";
    msg["content"] = question;

    String requestBody;
    serializeJson(doc, requestBody);

    int httpCode = https.POST(requestBody);

    if (httpCode == HTTP_CODE_OK) {
      String payload = https.getString();

      JsonDocument responseDoc;
      DeserializationError error = deserializeJson(responseDoc, payload);

      if (!error) {
        const char* content = responseDoc["choices"][0]["message"]["content"];
        strncpy(groqResponseBuffer, content, GROQ_RESPONSE_BUFFER_SIZE - 1);
        groqResponseBuffer[GROQ_RESPONSE_BUFFER_SIZE - 1] = '\0';
      } else {
        strcpy(groqResponseBuffer, "Fehler beim Parsen der Antwort");
        Serial.println(error.c_str());
      }
    } else {
      snprintf(groqResponseBuffer, GROQ_RESPONSE_BUFFER_SIZE, "HTTP-Fehler: %d", httpCode);
      Serial.println(https.getString());
    }

    https.end();
  } else {
    strcpy(groqResponseBuffer, "Verbindung zu Groq fehlgeschlagen");
  }

  return groqResponseBuffer;
}
float latitude = 0.0;
float longitude = 0.0;
bool resolveCity(const char* city) {
  HTTPClient http;
  String url = "https://geocoding-api.open-meteo.com/v1/search?name=" + String(city) + "&count=1&language=de";
  http.begin(url);
  int httpCode = http.GET();

  bool success = false;
  if (httpCode == 200) {
    String payload = http.getString();
    JsonDocument doc;
    DeserializationError error = deserializeJson(doc, payload);

    if (!error && doc["results"][0]["latitude"].is<float>()) {
      latitude = doc["results"][0]["latitude"];
      longitude = doc["results"][0]["longitude"];
      Serial.println("Stadt gefunden: " + String(city) 
                      + " (" + String(latitude, 4) + ", " + String(longitude, 4) + ")");
      success = true;
    } else {
      Serial.println("Stadt nicht gefunden!");
    }
  } else {
    Serial.print("Geocoding HTTP-Fehler: ");
    Serial.println(httpCode);
  }

  http.end();
  return success;
}
// Abfrageintervall in Millisekunden
const unsigned long interval = 60000; // alle 60 Sekunden
unsigned long previousMillis = 0;

void getWeather(volatile int &targetTemp, volatile int &targetHum) {
  if (WiFi.status() != WL_CONNECTED) {
    Serial.println("WLAN nicht verbunden!");
    return;
  }

  HTTPClient http;
  String url = "https://api.open-meteo.com/v1/forecast?latitude=" + String(latitude, 4)
              + "&longitude=" + String(longitude, 4)
              + "&current=temperature_2m,relative_humidity_2m,wind_speed_10m,weather_code";

  http.begin(url);
  int httpCode = http.GET();

  if (httpCode == 200) {
    String payload = http.getString();

    JsonDocument doc; // ArduinoJson v7
    DeserializationError error = deserializeJson(doc, payload);

    if (!error) {
      float temp = doc["current"]["temperature_2m"];
      int humidity = doc["current"]["relative_humidity_2m"];
      float wind = doc["current"]["wind_speed_10m"];
      int weatherCode = doc["current"]["weather_code"];
	  targetHum = humidity;
	  targetTemp = (int)temp;

      Serial.println("---- Aktuelles Wetter ----");
      Serial.print("Temperatur: "); Serial.print(temp); Serial.println(" °C");
      Serial.print("Luftfeuchtigkeit: "); Serial.print(humidity); Serial.println(" %");
      Serial.print("Windgeschwindigkeit: "); Serial.print(wind); Serial.println(" km/h");
      Serial.print("Wettercode: "); Serial.println(weatherCode);
      Serial.println("---------------------------");
    } else {
      Serial.print("JSON-Fehler: ");
      Serial.println(error.c_str());
    }
  } else {
    Serial.print("HTTP-Fehler: ");
    Serial.println(httpCode);
  }

  http.end();
}
int getDailyWeatherValue(uint8_t dayIndex, bool maximum, bool rainChance) {
  if (WiFi.status() != WL_CONNECTED) {
    Serial.println("WLAN nicht verbunden!");
    return;
  }

  HTTPClient http;
  String url = "https://api.open-meteo.com/v1/forecast?latitude=" + String(latitude, 4)
              + "&longitude=" + String(longitude, 4)
              + "&current=temperature_2m,relative_humidity_2m,wind_speed_10m,weather_code";

  http.begin(url);
  int httpCode = http.GET();

  if (httpCode == 200) {
    String payload = http.getString();

    JsonDocument doc; // ArduinoJson v7
    DeserializationError error = deserializeJson(doc, payload);
  http.end();
  if (error) return 0;
  if (rainChance) return (int)round(doc["daily"]["precipitation_probability_max"][dayIndex] | 0);
  return (int)round(doc["daily"][maximum ? "temperature_2m_max" : "temperature_2m_min"][dayIndex] | 0.0);
  }
}
int getRainChanceNext5Days() {
  int result = 0;
  for (uint8_t day = 0; day < 5; day++) result = max(result, getDailyWeatherValue(day, false, true));
  return result;
}
bool textToSpeech(const String &text) {
  WiFiClientSecure client;
  client.setInsecure();

  if (!client.connect("api.elevenlabs.io", 443)) {
    Serial.println("FEHLER: Verbindung zu ElevenLabs fehlgeschlagen");
    return false;
  }

  // Anführungszeichen/Backslashes im Text escapen, sonst kaputtes JSON
  String safeText = text;
  safeText.replace("\\", "\\\\");
  safeText.replace("\"", "\\\"");

  String jsonBody = "{\"text\":\"" + safeText + "\",\"model_id\":\"eleven_multilingual_v2\"}";

  String voiceId = "21m00Tcm4TlvDq8ikWAM";  // austauschbar gegen eine andere ElevenLabs-Stimme
  String path = "/v1/text-to-speech/" + voiceId + "?output_format=pcm_16000";

  client.print("POST " + path + " HTTP/1.1\r\n");
  client.print("Host: api.elevenlabs.io\r\n");
  client.print("xi-api-key: sk_1731da587d5e576445d01d32665f8fe7cd1399e3b097329c\r\n");
  client.print("Content-Type: application/json\r\n");
  client.print("Content-Length: " + String(jsonBody.length()) + "\r\n");
  client.print("Connection: close\r\n\r\n");
  client.print(jsonBody);

  // Auf Antwort warten
  unsigned long timeout = millis();
  while (client.connected() && !client.available()) {
    if (millis() - timeout > 15000) {
      Serial.println("FEHLER: Timeout beim Warten auf Antwort");
      client.stop();
      return false;
    }
  }

  // HTTP-Header überspringen (bis zur Leerzeile)
  bool headersDone = false;
  while (client.connected() || client.available()) {
    if (client.available()) {
      String line = client.readStringUntil('\n');
      if (line == "\r") { headersDone = true; break; }
    }
  }
  if (!headersDone) {
    Serial.println("FEHLER: Keine gültige Antwort erhalten");
    client.stop();
    return false;
  }

  // Ab hier kommen rohe PCM-Daten -- häppchenweise direkt an den DAC weiterreichen
  uint8_t chunk[512];
  size_t bytesWritten;
  while (client.connected() || client.available()) {
    if (client.available()) {
      int len = client.read(chunk, sizeof(chunk));
      if (len > 0) {
        i2s_write(I2S_NUM_0, chunk, len, &bytesWritten, portMAX_DELAY);
      }
    }
  }

  client.stop();
  return true;
}
	
void drawText(int16_t x, int16_t y, const char *text, uint16_t color, uint8_t size) {
  tft.setCursor(x, y);
  tft.setTextColor(color);
  tft.setTextSize(size);
  tft.print(text);
}

void drawButton(int16_t x, int16_t y, int16_t w, int16_t h, int16_t radius, uint16_t fill, uint16_t textColor, const char *text) {
  tft.fillRoundRect(x, y, w, h, radius, fill);
  tft.drawRoundRect(x, y, w, h, radius, ILI9341_WHITE);
  tft.setTextSize(2);
  tft.setTextColor(textColor);
  int16_t tx = x + (w - strlen(text) * 12) / 2;
  int16_t ty = y + (h - 16) / 2;
  tft.setCursor(tx, ty);
  tft.print(text);
}

void drawProgress(int16_t x, int16_t y, int16_t w, int16_t h, uint8_t value, uint16_t color, uint16_t background) {
  tft.fillRect(x, y, w, h, background);
  tft.fillRect(x, y, (w * constrain(value, 0, 100)) / 100, h, color);
  tft.drawRect(x, y, w, h, color);
}

void drawCheckbox(int16_t x, int16_t y, bool checked, uint16_t color, uint8_t size, const char *label) {
  tft.drawRect(x, y, 14, 14, color);
  if (checked) { tft.drawLine(x + 3, y + 7, x + 6, y + 11, color); tft.drawLine(x + 6, y + 11, x + 12, y + 3, color); }
  drawText(x + 20, y, label, color, size);
}

void drawInputField(int16_t x, int16_t y, int16_t w, int16_t h, const char *value, const char *placeholder, uint16_t bg, uint16_t color) {
  tft.fillRect(x, y, w, h, bg);
  tft.drawRect(x, y, w, h, ILI9341_WHITE);
  tft.setTextSize(1);
  tft.setCursor(x + 4, y + h / 2 - 4);
  if (strlen(value) > 0) {
    tft.setTextColor(color);
    tft.print(value);
  } else {
    tft.setTextColor(0x7BEF);
    tft.print(placeholder);
  }
}

void drawListbox(int16_t x, int16_t y, int16_t w, int16_t h, int16_t rowHeight, const char **items, int itemCount, int selectedIndex, uint16_t bg, uint16_t color, uint16_t selectedColor) {
  tft.fillRect(x, y, w, h, bg);
  tft.drawRect(x, y, w, h, ILI9341_WHITE);
  tft.setTextSize(1);
  for (int i = 0; i < itemCount; i++) {
    int16_t rowY = y + i * rowHeight;
    if (rowY + rowHeight > y + h) break;
    if (i == selectedIndex) tft.fillRect(x + 1, rowY, w - 2, rowHeight, 0x18E3);
    tft.setTextColor(i == selectedIndex ? selectedColor : color);
    tft.setCursor(x + 4, rowY + rowHeight / 2 - 4);
    tft.print(items[i]);
  }
}

void drawMultilineText(int16_t x, int16_t y, int16_t w, const char *text, uint16_t color, uint8_t size, uint8_t lineSpacing) {
  tft.setTextColor(color);
  tft.setTextSize(size);
  int16_t charW = 6 * size;
  int16_t lineH = 8 * size + lineSpacing;
  int16_t maxChars = max((int16_t)1, (int16_t)(w / charW));
  char buffer[161];
  int16_t cursorY = y;
  int16_t len = strlen(text);
  int16_t pos = 0;
  while (pos < len) {
    int16_t lineLen = 0;
    int16_t lastSpace = -1;
    while (pos + lineLen < len && lineLen < maxChars && text[pos + lineLen] != '\n') {
      if (text[pos + lineLen] == ' ') lastSpace = lineLen;
      lineLen++;
    }
    bool brokeOnNewline = (pos + lineLen < len && text[pos + lineLen] == '\n');
    if (!brokeOnNewline && pos + lineLen < len && lastSpace >= 0) lineLen = lastSpace;
    int16_t copyLen = min(lineLen, (int16_t)(sizeof(buffer) - 1));
    strncpy(buffer, text + pos, copyLen);
    buffer[copyLen] = '\0';
    tft.setCursor(x, cursorY);
    tft.print(buffer);
    cursorY += lineH;
    pos += lineLen;
    if (pos < len && (text[pos] == '\n' || text[pos] == ' ')) pos++;
  }
}

void drawPage_page_home() {
  tft.fillRect(0, 0, 320, 240, 0xFFFF);
  drawText(17, 18, "OpenAlex", 0x4432, 6);
  drawProgress(15, 204, 289, 16, 0, 0x2636, 0x2188);
  // Variable: int fortschritt_boot
  tft.fillCircle(138, 135, 25, 0x2625);
  drawText(124, 126, "On", 0xFFFF, 2);
  // TouchZone
  // TouchZone
}

void drawPage_page_mseffrpg() {
  tft.fillRect(0, 0, 320, 240, 0xFFFF);
  drawProgress(22, 57, 180, 16, 65, 0x2636, 0x2188);
  drawProgress(22, 84, 180, 16, 31, 0xFEA0, 0x2188);
  drawText(209, 57, String(hum1).c_str(), 0x0000, 2);
  drawText(208, 83, String(temp1).c_str(), 0x0000, 2);
  tft.fillRect(0, 28, 320, 4, 0x859C);
  tft.drawRect(13, 49, 278, 63, 0x23D7);
  // TouchZone
  // Variable: int temp1
  // Variable: int hum1
  // Code-Executor (interval)
  drawText(265, 83, " C", 0x0000, 2);
  drawText(261, 58, "%", 0x0000, 2);
  drawText(0, 0, "Wetter-Uebersicht", 0x2E57, 3);
  drawText(101, 135, String(time_hour).c_str(), 0x0000, 3);
  drawText(138, 134, ":", 0x0000, 3);
  drawText(157, 135, String(time_min).c_str(), 0x0000, 3);
  // Variable: int time_hour
  // Variable: int time_min
  // Code-Executor (interval)
}

void drawPage_page_msefx142() {
  tft.fillRect(0, 0, 320, 240, 0x18E3);
  tft.drawRect(15, 49, 120, 165, 0x23D7);
  tft.drawRect(144, 49, 120, 165, 0x23D7);
  drawButton(22, 186, 105, 25, 25, 0x1947, 0xFFFF, "Start");
  drawButton(152, 185, 105, 25, 50, 0x1947, 0xFFFF, "Start");
  drawMultilineText(26, 87, 97,"Stellen Sie ein, wie Sie OpenAlex benutzen möchten und konfigurieren Sie die Funktionen.", 0xFFFF, 1, 4);
  drawMultilineText(151, 89, 105,"Lassen Sie sich das aktuelle Wetter auf einen Blick anzeigen und lesen Sie die Vorhersage für morgen.", 0xFFFF, 1, 4);
  drawText(23, 54, "Setup", 0xFFFF, 2);
  drawText(158, 56, "Wetter", 0xFFFF, 2);
  // TouchZone
  tft.fillRect(0, 20, 320, 2, 0xFFFF);
  drawText(0, 0, String(WLANSSID).c_str(), 0xFFFF, 2);
  drawText(196, 0, "No Accu", 0xFFFF, 2);
  // TouchZone
}

void drawPage_page_mseg45ti() {
  tft.fillRect(0, 0, 320, 240, 0xFFFF);
  drawListbox(32, 66, 249, 126, 31, listSelected_items, listSelected_itemCount, listSelected, 0x7BCC, 0x0000, 0x09EC);
  drawText(24, 0, "Einstellungen", 0x5557, 5);
  // TouchZone
  drawButton(88, 196, 120, 36, 5, 0x1947, 0xFFFF, "Open Entry");
  // User Declaration
}

void drawPage_page_mseugjjt() {
  tft.fillRect(0, 0, 320, 240, 0xFFFF);
  drawText(0, 0, "Network Settings", 0x0CBF, 4);
  tft.fillRect(0, 35, 320, 2, 0x5416);
  drawInputField(15, 56, 233, 28, stadt, "Stadt eingeben", 0x3186, 0xFFFF);
  // TouchZone
}

void drawPage_page_mseuudl2() {
  tft.fillRect(0, 0, 320, 240, 0x2104);
  drawText(2, 84, "OpenAlex", 0x39E7, 6);
  // TouchZone
  tft.drawRect(147, 49, 134, 165, 0x23D7);
  drawButton(165, 178, 105, 25, 50, 0x1947, 0xFFFF, "Try Out");
  drawInputField(156, 59, 118, 28, frage, "Question...", 0x3186, 0xFFFF);
  // User Declaration
  drawMultilineText(159, 96, 106,String(antwort).c_str(), 0xFFFF, 1, 4);
  // TouchZone
  tft.drawRect(29, 48, 105, 165, 0x23D7);
  drawText(35, 52, "Widgets", 0xFFFF, 2);
  drawMultilineText(37, 78, 87,"Die Wettervorhersage. Detailliert, grafisch, schoen.", 0xFFFF, 1, 4);
  drawButton(36, 183, 91, 23, 50, 0x1947, 0xFFFF, "Try Out");
}

void drawPage_page_mseuxm3z() {
  tft.fillRect(0, 0, 320, 240, 0xFFFF);
  // TouchZone
  drawText(0, 0, "Ueber OpenAlex", 0x23F3, 3);
  drawMultilineText(78, 51, 180,"Aktualisieren Sie OpenAlex auf Firmware Rev. 2.12.477 um Sprachbedienung zu nutzen.   \\n Über OpenAlex: OpenAlex, App, Runs on: TBS For further information see the OS's Boot Menu.", 0x0000, 1, 4);
  tft.fillCircle(40, 69, 25, 0x3E24);
  drawText(31, 50, "i", 0xFFFF, 4);
  tft.drawRect(7, 33, 300, 200, 0x23D7);
  tft.drawBitmap(160, 98, bitmap_msoqagwmwuz8_data, 150, 165, 0xF800);
}

void drawPage_page_msg02tj0() {
  tft.fillRect(0, 0, 320, 240, 0x23D7);
  drawText(43, 0, "Zeiteinstellung", 0xFFFF, 2);
  drawText(140, 42, String(time_hour).c_str(), 0xFFFF, 2);
  drawText(141, 122, String(time_min).c_str(), 0xFFFF, 2);
  drawButton(18, 34, 120, 36, 5, 0x1947, 0xFFFF, "+");
  drawButton(17, 73, 120, 36, 5, 0x1947, 0xFFFF, "-");
  drawButton(17, 115, 120, 36, 5, 0x1947, 0xFFFF, "+");
  drawButton(17, 154, 120, 36, 5, 0x1947, 0xFFFF, "-");
  drawButton(166, 153, 120, 36, 50, 0x1947, 0xFFFF, "Apply");
}

void drawPage_page_msk15djy() {
  tft.fillRect(0, 0, 320, 240, 0xFFFF);
  drawText(0, 0, "Accessibility", 0x02B5, 4);
  tft.fillRect(0, 36, 320, 2, 0x02B5);
  tft.fillCircle(145, 127, 40, 0x03DF);
  tft.fillCircle(144, 127, 33, 0x02B5);
  tft.drawCircle(146, 127, 47, 0x2636);
  drawText(120, 118, "Speak", 0xFFFF, 2);
  // TouchZone
  drawMultilineText(0, 43, 320,String(transcript).c_str(), 0x0000, 1, 4);
  // TouchZone
  // User Declaration
}

void drawPage_page_msopvrt5() {
  tft.fillRect(0, 0, 320, 240, 0xFFFF);
  drawText(0, 0, "Vorhersage", 0x457E, 5);
  tft.fillRect(0, 38, 320, 2, 0x457E);
  drawText(21, 109, "<", 0x0000, 6);
  drawText(241, 107, ">", 0x0000, 6);
  // TouchZone
  // TouchZone
  drawText(112, 70, "Heute", 0x45DF, 2);
  tft.fillCircle(152, 122, 25, 0xFE62);
  tft.fillRect(95, 151, 70, 26, 0x6B4D);
  tft.fillCircle(120, 141, 25, 0x6B4D);
  tft.fillCircle(146, 148, 13, 0x6B4D);
  tft.fillCircle(49, 209, 5, 0x2636);
  drawText(60, 199, String(rainChance).c_str(), 0x0000, 2);
  drawProgress(111, 203, 20, 8, 17, 0xF880, 0x2188);
  drawProgress(164, 203, 20, 8, 81, 0x4FE1, 0x2188);
  drawText(129, 197, String(temperatureMinimum).c_str(), 0x0000, 2);
  drawText(183, 197, String(temperatureMaximum).c_str(), 0x0841, 2);
  // Wetter-Spezialvariable: Regenwahrscheinlichkeit
  // Wetter-Spezialvariable: Temperatur
  // Wetter-Spezialvariable: Temperatur
  tft.drawBitmap(85, 68, bitmap_msosfnntgvrw_data, 97, 123, 0x0000);
  // TouchZone
}

void drawPage_page_msorfavx() {
  tft.fillRect(0, 0, 320, 240, 0x0000);
  drawText(0, 0, "Boot Menu [NOT FOR PU]", 0xFFFF, 2);
  drawListbox(0, 23, 320, 171, 40, listSelected123_items, listSelected123_itemCount, listSelected123, 0x0000, 0xFFFF, 0xFE60);
  drawButton(80, 201, 120, 36, 0, 0x0000, 0xFFFF, "Go it");
}

void drawPage_page_msoszihg() {
  tft.drawBitmap(181, 155, bitmap_msoszk9abbgl_data, 98, 114, 0x0000);
  tft.drawBitmap(57, 173, bitmap_msoszphm41eu_data, 101, 121, 0x0000);
}

void drawPage_page_msq16qov() {
  tft.fillRect(0, 0, 320, 240, 0xFFFF);
  drawText(0, 0, "WLAN-Setup", 0x2A54, 4);
  drawInputField(21, 39, 140, 28, WLANSSID, "SSID (Name)...", 0x3186, 0xFFFF);
  drawInputField(20, 79, 140, 28, WLANPASSWORD, "Passwort", 0x3186, 0xFFFF);
  drawCheckbox(168, 45, checkboxState123, 0x0000, 2, "Merken");
  drawButton(155, 76, 120, 36, 5, 0x1947, 0xFFFF, "Verbinden");
}

void drawPage_page_msq1dru6() {
  tft.fillRect(0, 0, 320, 240, 0x23D7);
  drawButton(10, 11, 120, 50, 50, 0xFFFF, 0x0000, "WLAN");
  drawButton(134, 13, 120, 50, 50, 0x23D7, 0x0000, "Mikrofon");
  drawButton(133, 80, 120, 50, 50, 0xFFFF, 0x0000, "WLAN Flash");
  drawText(131, 202, "^", 0xFFFF, 6);
  // TouchZone
  // User Declaration
  // User Setup Code
  drawButton(58, 138, 181, 30, 5, 0x1947, 0xFFFF, "Run TBS SmartLight Test");
}

void drawCurrentPage() {
  tft.fillScreen(ILI9341_BLACK);
  
  switch (currentPage) {
    case PAGE_PAGE_HOME: drawPage_page_home(); break;
    case PAGE_PAGE_MSEFFRPG: drawPage_page_mseffrpg(); break;
    case PAGE_PAGE_MSEFX142: drawPage_page_msefx142(); break;
    case PAGE_PAGE_MSEG45TI: drawPage_page_mseg45ti(); break;
    case PAGE_PAGE_MSEUGJJT: drawPage_page_mseugjjt(); break;
    case PAGE_PAGE_MSEUUDL2: drawPage_page_mseuudl2(); break;
    case PAGE_PAGE_MSEUXM3Z: drawPage_page_mseuxm3z(); break;
    case PAGE_PAGE_MSG02TJ0: drawPage_page_msg02tj0(); break;
    case PAGE_PAGE_MSK15DJY: drawPage_page_msk15djy(); break;
    case PAGE_PAGE_MSOPVRT5: drawPage_page_msopvrt5(); break;
    case PAGE_PAGE_MSORFAVX: drawPage_page_msorfavx(); break;
    case PAGE_PAGE_MSOSZIHG: drawPage_page_msoszihg(); break;
    case PAGE_PAGE_MSQ16QOV: drawPage_page_msq16qov(); break;
    case PAGE_PAGE_MSQ1DRU6: drawPage_page_msq1dru6(); break;
  }
}

const char* kbRows[4] = {"1234567890", "qwertyuiop", "asdfghjkl", "zxcvbnm"};

void openKeyboard(char* target, uint8_t targetSize) {
  keyboardActive = true;
  keyboardTarget = target;
  keyboardTargetSize = targetSize;
  drawKeyboard();
}

void drawKeyboard() {
  tft.fillRect(0, 96, 320, 144, ILI9341_NAVY);
  int16_t rowY = 98;
  for (uint8_t r = 0; r < 4; r++) {
    const char* row = kbRows[r];
    uint8_t len = strlen(row);
    int16_t keyW = 320 / len;
    for (uint8_t i = 0; i < len; i++) {
      tft.drawRect(i * keyW, rowY, keyW, 22, ILI9341_WHITE);
      tft.setTextColor(ILI9341_WHITE);
      tft.setTextSize(1);
      tft.setCursor(i * keyW + keyW / 2 - 3, rowY + 7);
      tft.print(row[i]);
    }
    rowY += 24;
  }
  tft.drawRect(0, rowY, 90, 22, ILI9341_WHITE);
  tft.setTextColor(ILI9341_WHITE);
  tft.setCursor(24, rowY + 7); tft.print("<-");
  tft.drawRect(90, rowY, 140, 22, ILI9341_WHITE);
  tft.setCursor(142, rowY + 7); tft.print("LEER");
  tft.drawRect(230, rowY, 90, 22, ILI9341_WHITE);
  tft.setCursor(258, rowY + 7); tft.print("OK");
}

void handleKeyboardTouch(int16_t x, int16_t y) {
  int16_t rowY = 98;
  for (uint8_t r = 0; r < 4; r++) {
    const char* row = kbRows[r];
    uint8_t len = strlen(row);
    int16_t keyW = 320 / len;
    if (y >= rowY && y < rowY + 22) {
      uint8_t i = x / keyW;
      if (i < len) {
        uint8_t pos = strlen(keyboardTarget);
        if (pos < keyboardTargetSize - 1) {
          keyboardTarget[pos] = row[i];
          keyboardTarget[pos + 1] = '\0';
        }
      }
      drawKeyboard();
      return;
    }
    rowY += 24;
  }
  if (y >= rowY && y < rowY + 22) {
    if (x < 90) {
      uint8_t pos = strlen(keyboardTarget);
      if (pos > 0) keyboardTarget[pos - 1] = '\0';
    } else if (x < 230) {
      uint8_t pos = strlen(keyboardTarget);
      if (pos < keyboardTargetSize - 1) {
        keyboardTarget[pos] = ' ';
        keyboardTarget[pos + 1] = '\0';
      }
    } else {
      keyboardActive = false;
      drawCurrentPage();
      return;
    }
  }
  drawKeyboard();
}

void handleTouch(int16_t startX, int16_t startY, int16_t endX, int16_t endY) {
  int16_t dx = endX - startX;
  int16_t dy = endY - startY;

  bool tap = abs(dx) < 15 && abs(dy) < 15;
  bool swipeLeft = dx < -30 && abs(dx) > abs(dy);
  bool swipeRight = dx > 30 && abs(dx) > abs(dy);
  bool swipeUp = dy < -30 && abs(dy) > abs(dx);
  bool swipeDown = dy > 30 && abs(dy) > abs(dx);

  if (keyboardActive) {
    if (!tap) return;
    handleKeyboardTouch(endX, endY);
    return;
  }

  switch (currentPage) {
    case PAGE_PAGE_HOME:
      if (endX >= 99 && endX < 179 && endY >= 104 && endY < 164) {
  if (!tap) break;
currentPage = PAGE_PAGE_MSEFX142;
drawCurrentPage();
break;
}
      if (endX >= 0 && endX < 80 && endY >= 0 && endY < 60) {
  if (!tap) break;
currentPage = PAGE_PAGE_MSORFAVX;
drawCurrentPage();
break;
}
      break;
    case PAGE_PAGE_MSEFFRPG:
      if (endX >= 1 && endX < 321 && endY >= 0 && endY < 110) {
  if (!swipeDown) break;
currentPage = PAGE_PAGE_MSEFX142;
drawCurrentPage();
break;
}
      break;
    case PAGE_PAGE_MSEFX142:
      if (endX >= 22 && endX < 127 && endY >= 186 && endY < 211) {
  if (!tap) break;
currentPage = PAGE_PAGE_MSEG45TI;
drawCurrentPage();
break;
}
      if (endX >= 152 && endX < 257 && endY >= 185 && endY < 210) {
  if (!tap) break;
currentPage = PAGE_PAGE_MSEFFRPG;
drawCurrentPage();
break;
}
      if (endX >= 214 && endX < 294 && endY >= 0 && endY < 240) {
  if (!swipeLeft) break;
currentPage = PAGE_PAGE_MSEUUDL2;
drawCurrentPage();
break;
}
      if (endX >= 0 && endX < 229 && endY >= 0 && endY < 60) {
  if (!swipeDown) break;
currentPage = PAGE_PAGE_MSQ1DRU6;
drawCurrentPage();
break;
}
      break;
    case PAGE_PAGE_MSEG45TI:
      if (endX >= 32 && endX < 281 && endY >= 66 && endY < 192) {
  if (!tap) break;
  int row = (endY - 66) / 31;
  if (row >= 0 && row < 4) {
    listSelected = row;
    drawCurrentPage();
  }
  break;
}
      if (endX >= 0 && endX < 320 && endY >= 0 && endY < 60) {
  if (!swipeDown) break;
currentPage = PAGE_PAGE_MSEFX142;
drawCurrentPage();
break;
}
      if (endX >= 88 && endX < 208 && endY >= 196 && endY < 232) {
  if (!tap) break;
switch(listSelected) {
  case 0:
    currentPage = PAGE_PAGE_MSEUGJJT;
    drawCurrentPage();
    break;
  case 1:
    currentPage = PAGE_PAGE_MSEUXM3Z;
    drawCurrentPage();
    break;
  case 2:
    currentPage = PAGE_PAGE_MSG02TJ0;
    drawCurrentPage();
    break;
  case 3:
    confirmDialog("Devmode");
    developerMode = true;
    drawCurrentPage();
    break;
  default:
    break;
}
drawCurrentPage();
break;
}
      break;
    case PAGE_PAGE_MSEUGJJT:
      if (endX >= 15 && endX < 248 && endY >= 56 && endY < 84) {
  if (!tap) break;
  openKeyboard(stadt, sizeof(stadt));
  break;
}
      if (endX >= 0 && endX < 320 && endY >= 0 && endY < 47) {
  if (!swipeUp) break;
currentPage = PAGE_PAGE_MSEG45TI;
drawCurrentPage();
break;
}
      break;
    case PAGE_PAGE_MSEUUDL2:
      if (endX >= 0 && endX < 80 && endY >= 0 && endY < 240) {
  if (!swipeRight) break;
currentPage = PAGE_PAGE_MSEFX142;
drawCurrentPage();
break;
}
      if (endX >= 165 && endX < 270 && endY >= 178 && endY < 203) {
  if (!tap) break;
String systemPrompt = "Du bist ein freundlicher KI-Assistent. Dein Name ist OpenAlex.\n"
                       "Du informierst den Nutzer kurz und prägnant über das Wetter oder andere Fragen die er dir stellt.\n"
                       "Hier hast du die aktuellen Daten: In der Stadt des Benutzers sind " + String(temp1) + "°C und die Luftfeuchte beträgt " + String(hum1) + "%. \n"
                       "Antworte mit maximal 256 Zeichen, also in ein bis drei Sätzen.";
antwort = askGroq("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", frage, systemPrompt.c_str());
textToSpeech(String(antwort));
drawCurrentPage();
drawCurrentPage();
break;
}
      if (endX >= 156 && endX < 274 && endY >= 59 && endY < 87) {
  if (!tap) break;
  openKeyboard(frage, sizeof(frage));
  break;
}
      if (endX >= 216 && endX < 296 && endY >= 0 && endY < 240) {
  if (!swipeLeft) break;
currentPage = PAGE_PAGE_MSK15DJY;
drawCurrentPage();
break;
}
      if (endX >= 36 && endX < 127 && endY >= 183 && endY < 206) {
  if (!tap) break;
if (developerMode) {
  currentPage = PAGE_PAGE_MSOPVRT5;
  drawCurrentPage();
}
drawCurrentPage();
break;
}
      break;
    case PAGE_PAGE_MSEUXM3Z:
      if (endX >= 0 && endX < 320 && endY >= 0 && endY < 60) {
  if (!swipeDown) break;
currentPage = PAGE_PAGE_MSEFX142;
drawCurrentPage();
break;
}
      break;
    case PAGE_PAGE_MSG02TJ0:
      if (endX >= 18 && endX < 138 && endY >= 34 && endY < 70) {
  if (!tap) break;
time_hour++;
drawCurrentPage();
break;
}
      if (endX >= 17 && endX < 137 && endY >= 73 && endY < 109) {
  if (!tap) break;
time_hour--;
drawCurrentPage();
drawCurrentPage();
break;
}
      if (endX >= 17 && endX < 137 && endY >= 115 && endY < 151) {
  if (!tap) break;
time_min++;
drawCurrentPage();
drawCurrentPage();
break;
}
      if (endX >= 17 && endX < 137 && endY >= 154 && endY < 190) {
  if (!tap) break;
time_min--;
drawCurrentPage();
drawCurrentPage();
break;
}
      if (endX >= 166 && endX < 286 && endY >= 153 && endY < 189) {
  if (!tap) break;
currentPage = PAGE_PAGE_MSEG45TI;
drawCurrentPage();
break;
}
      break;
    case PAGE_PAGE_MSK15DJY:
      if (endX >= 97 && endX < 195 && endY >= 77 && endY < 173) {
  if (!tap) break;
tft.fillRect(20, 200, 280, 40, 0x03DF);
if (recordAudio()) {
  transcript = sendToGroqSTT("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");
  
  Serial.println(transcript);
  freeAudioBuffer();  // wichtig: RAM sofort wieder freigeben
}
drawCurrentPage();
break;
}
      if (endX >= 0 && endX < 320 && endY >= 3 && endY < 63) {
  if (!swipeDown) break;
currentPage = PAGE_PAGE_MSEUUDL2;
drawCurrentPage();
break;
}
      break;
    case PAGE_PAGE_MSOPVRT5:
      if (endX >= 0 && endX < 80 && endY >= 112 && endY < 172) {
  if (!tap) break;
break;
}
      if (endX >= 213 && endX < 293 && endY >= 109 && endY < 169) {
  if (!tap) break;
break;
}
      if (endX >= 0 && endX < 320 && endY >= 0 && endY < 60) {
  if (!swipeDown) break;
currentPage = PAGE_PAGE_MSEUUDL2;
drawCurrentPage();
break;
}
      break;
    case PAGE_PAGE_MSORFAVX:
      if (endX >= 0 && endX < 320 && endY >= 23 && endY < 194) {
  if (!tap) break;
  int row = (endY - 23) / 40;
  if (row >= 0 && row < 4) {
    listSelected123 = row;
    drawCurrentPage();
  }
  break;
}
      if (endX >= 80 && endX < 200 && endY >= 201 && endY < 237) {
  if (!tap) break;
switch(listSelected123) {
  case 0:
    confirmDialog("E07 Not implemented");
    break;
  case 1:
    confirmDialog("Will be deleted now.");
    break;
  case 2:
textWindow("---WARNING---\n\nFlashing the ESP32 via WLAN without a valid binary can cause a softbrick.\n\nYou have 5 Seconds from now to abort by pressing RESET or powering off.");
confirmDialog("A03 Enter_Flashing_Mode");
enterFlashMode();
    break;
  case 3:
    textWindow("TBS - The OS you won't forget\nThis Device runs its 'App' on TBS, the free OPerating System of TBS. \n\nDevice ID: CYD_msormg87vgkl");
    break;
  default:
    break;
}
drawCurrentPage();
break;
}
      break;
    case PAGE_PAGE_MSOSZIHG:
      break;
    case PAGE_PAGE_MSQ16QOV:
      if (endX >= 21 && endX < 161 && endY >= 39 && endY < 67) {
  if (!tap) break;
  openKeyboard(WLANSSID, sizeof(WLANSSID));
  break;
}
      if (endX >= 20 && endX < 160 && endY >= 79 && endY < 107) {
  if (!tap) break;
  openKeyboard(WLANPASSWORD, sizeof(WLANPASSWORD));
  break;
}
      if (endX >= 168 && endX < 272 && endY >= 45 && endY < 63) {
  if (!tap) break;
  checkboxState123 = !checkboxState123;
  drawCurrentPage();
  break;
}
      if (endX >= 155 && endX < 275 && endY >= 76 && endY < 112) {
  if (!tap) break;
textWindow("Connecting to Network... \n\n(i) 5 Seconds");
confirmDialog("A02 Connect_WiFi");
WiFi.begin(WLANSSID, WLANPASSWORD);
currentPage = PAGE_PAGE_MSEFFRPG;
drawCurrentPage();
drawCurrentPage();
break;
}
      break;
    case PAGE_PAGE_MSQ1DRU6:
      if (endX >= 10 && endX < 130 && endY >= 11 && endY < 61) {
  if (!tap) break;
currentPage = PAGE_PAGE_MSQ16QOV;
drawCurrentPage();
break;
}
      if (endX >= 134 && endX < 254 && endY >= 13 && endY < 63) {
  if (!tap) break;
confirmDialog("A01 Init_Sound");
initMicADC();
initSpeaker();

drawCurrentPage();
break;
}
      if (endX >= 133 && endX < 253 && endY >= 80 && endY < 130) {
  if (!tap) break;
textWindow("---WARNING---\n\nFlashing the ESP32 via WLAN without a valid binary can cause a softbrick.\n\nYou have 5 Seconds from now to abort by pressing RESET or powering off.");
confirmDialog("A03 Enter_Flashing_Mode");
enterFlashMode();
drawCurrentPage();
break;
}
      if (endX >= 0 && endX < 320 && endY >= 179 && endY < 239) {
  if (!swipeUp) break;
currentPage = PAGE_PAGE_MSEFX142;
drawCurrentPage();
break;
}
      if (endX >= 58 && endX < 239 && endY >= 138 && endY < 168) {
  if (!tap) break;
writeHello();
drawCurrentPage();
break;
}
      break;
  }
}

void setup() {
  Serial.begin(115200);
   pinMode(21, OUTPUT);
  digitalWrite(21, HIGH);
WiFi.begin(ssid, password);
Serial.print("Verbinde mit WLAN");
while (WiFi.status() != WL_CONNECTED) {
  delay(500);
    Serial.print(".");
}
//use getWeather
  SPI.begin(14, 12, 13, 15);
  tft.begin();
  tft.setRotation(1);
  touchscreenSPI.begin(XPT2046_CLK, XPT2046_MISO, XPT2046_MOSI, XPT2046_CS);
  ts.begin(touchscreenSPI);
  ts.setRotation(0);
   
  resolveCity(cityName);
  rainChance = getDailyWeatherValue(0, false, true); weatherTimer_weatherRainChance_msoqdwjy5zxj = millis();
  temperatureMinimum = getDailyWeatherValue(0, false, false); weatherTimer_weatherTemperature_msoqf17cka3a = millis();
  temperatureMaximum = getDailyWeatherValue(0, true, false); weatherTimer_weatherTemperature_msoqg3507efu = millis();
  //updateSpecialWeather(true);
  // Code für setup()
initMatrix();

  drawCurrentPage();
}

void loop() {
  if (ts.tirqTouched() && ts.touched()) {
    TS_Point p = ts.getPoint();
    // Bei falscher Orientierung: Touch-Min/Max im Builder kalibrieren oder X/Y tauschen.
    
int16_t x = map(p.y, 200, 3800, tft.width() - 1, 0);

// p.x wird direkt auf die Y-Achse des Displays gelegt
int16_t y = map(p.x, 200, 3800, 0, tft.height() - 1);

// Begrenzung auf die Display-Pixel (320x240)
x = constrain(x, 0, tft.width() - 1);
y = constrain(y, 0, tft.height() - 1);
int afgf = y ;
int bfgf = x ;
x = 320 - bfgf;
x = x + (0.05*x);
y = 240 - afgf + 4;
if (developerMode) {
tft.fillCircle(x, y, 3, ILI9341_RED);
}
	 if (!touchActive) {
      touchActive = true;
      touchStartX = x;
      touchStartY = y;
    }
    touchLastX = x;
    touchLastY = y;
  } else if (touchActive) {
    touchActive = false;
    handleTouch(touchStartX, touchStartY, touchLastX, touchLastY);
  }
  //updateSpecialWeather();
  
  if (millis() - codeAPI1 > 27000) {
    codeAPI1 = millis();
        if (currentPage == PAGE_PAGE_MSEFFRPG || currentPage == PAGE_PAGE_MSOPVRT5) {
    // Wetter-Werte setzen
    if (resolveCity(stadt)) {
      getWeather(temp1, hum1);
    } else {
      Serial.println("Abbruch: Keine gültigen Koordinaten.");
    }
      drawCurrentPage();
    }
  }

  
  if (millis() - time1 > 60000) {
    time1 = millis();
        // Dein Arduino-Code hier
    time_min++;
    if (time_min >= 59) {
    time_min = 0;
    time_hour++;
    }
    if (time_hour >= 24) {
    time_min = 0;
    time_hour = 0;
    }
  }

  
  if (millis() - codeAPI1 > 27000) {
    codeAPI1 = millis();
        if (currentPage == PAGE_PAGE_MSEFFRPG || currentPage == PAGE_PAGE_MSOPVRT5) {
    // Wetter-Werte setzen
    if (resolveCity(stadt)) {
      getWeather(temp1, hum1);
      rainChance = getDailyWeatherValue(0, false, true);
      temperatureMinimum = getDailyWeatherValue(0, false, false);
      temperatureMaximum = getDailyWeatherValue(0, true, false);
    } else {
      Serial.println("Abbruch: Keine gültigen Koordinaten.");
    }
      drawCurrentPage();
    }
  }

  
  if (millis() - time1 > 60000) {
    time1 = millis();
        // Dein Arduino-Code hier
    time_min++;
    if (time_min >= 59) {
    time_min = 0;
    time_hour++;
    }
    if (time_hour >= 24) {
    time_min = 0;
    time_hour = 0;
    }
  }

  delay(10);
}
